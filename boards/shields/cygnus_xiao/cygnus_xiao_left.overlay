/*
 * Copyright (c) 2024 The ZMK Contributors
 *
 * SPDX-License-Identifier: MIT
 */

#include "cygnus_xiao.dtsi"

/*
 * XIAO BLE pin -> nRF52840 GPIO:
 *   D0 = P0.02, D1 = P0.03, D2 = P0.28, D3 = P0.29, D4 = P0.04, D5 = P0.05
 */
&kscan0 {
    col-gpios
        = <&gpio0 2 GPIO_ACTIVE_HIGH>    // D0 - Col0
        , <&gpio0 3 GPIO_ACTIVE_HIGH>    // D1 - Col1
        , <&gpio0 28 GPIO_ACTIVE_HIGH>   // D2 - Col2
        , <&gpio0 29 GPIO_ACTIVE_HIGH>   // D3 - Col3
        , <&gpio0 4 GPIO_ACTIVE_HIGH>    // D4 - Col4
        , <&gpio0 5 GPIO_ACTIVE_HIGH>    // D5 - Col5
        ;
};

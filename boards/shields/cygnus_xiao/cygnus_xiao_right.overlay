/*
 * Copyright (c) 2024 The ZMK Contributors
 *
 * SPDX-License-Identifier: MIT
 */

#include "cygnus_xiao.dtsi"

&default_transform {
    col-offset = <6>;
};

/*
 * XIAO nRF52840
 *
 * C0 -> D4
 * C1 -> D5
 * C2 -> D6
 * C3 -> D7
 * C4 -> D8
 * C5 -> D9
 */

&kscan0 {
    col-gpios
        = <&gpio0 4  GPIO_ACTIVE_HIGH>    // D4 - Col0
        , <&gpio0 5  GPIO_ACTIVE_HIGH>    // D5 - Col1
        , <&gpio1 11 GPIO_ACTIVE_HIGH>    // D6 - Col2
        , <&gpio1 12 GPIO_ACTIVE_HIGH>    // D7 - Col3
        , <&gpio1 13 GPIO_ACTIVE_HIGH>    // D8 - Col4
        , <&gpio1 14 GPIO_ACTIVE_HIGH>    // D9 - Col5
        ;
};